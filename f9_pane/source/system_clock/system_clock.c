/**
*********************************************************************************************************
*                                        multi_switch_control
*                                      (c) Copyright 2021-2031
*                                         All Rights Reserved
*
* @File    : 
* @By      : liwei
* @Version : V0.01
* 
*********************************************************************************************************
**/

/*
*********************************************************************************************************
Includes 
*********************************************************************************************************
*/
#include "user_type.h"
#include "sysctrl.h"
#include "flash.h"
#include "ddl.h"
#include "wdt.h"
#include "system_clock.h"
/*
*********************************************************************************************************
Define
*********************************************************************************************************
*/


/*
*********************************************************************************************************
Typedef
*********************************************************************************************************
*/



/*
*********************************************************************************************************
Variables
*********************************************************************************************************
*/

/*
*********************************************************************************************************
Function 
*********************************************************************************************************
*/

/***********************************************************************************************************
* @名称	: 
* @描述	: 
***********************************************************************************************************/
 uint32_t user_systick_config(uint32_t ticks)
{
  if ((ticks - 1UL) > SysTick_LOAD_RELOAD_Msk)
  {
    return (1UL);                                                   /* Reload value impossible */
  }

  SysTick->LOAD  = (uint32_t)(ticks - 1UL);                         /* set reload register */
  NVIC_SetPriority (SysTick_IRQn, (1UL << __NVIC_PRIO_BITS) - 1UL); /* set Priority for Systick Interrupt */
  SysTick->VAL   = 0UL;                                             /* Load the SysTick Counter Value */
  SysTick->CTRL  = SysTick_CTRL_CLKSOURCE_Msk |
                   SysTick_CTRL_TICKINT_Msk   |
                   SysTick_CTRL_ENABLE_Msk;                         /* Enable SysTick IRQ and SysTick Timer */
  return (0UL);                                                     /* Function successful */
}
/***********************************************************************************************************
* @名称	: 
* @描述	: 
***********************************************************************************************************/
static void watchdog_init(void)
{
    /*< 开启WDT外设时钟*/
    Sysctrl_SetPeripheralGate(SysctrlPeripheralWdt,TRUE);
    /*< WDT 初始化 3秒*/
    Wdt_Init(WdtResetEn, WdtT3s28);
	/*< 启动 WDT*/
    Wdt_Start();
}
/***********************************************************************************************************
* @名称	: 
* @描述	: 
***********************************************************************************************************/
void watchdog_feed(void)
{
	/* 喂狗*/
	Wdt_Feed();   
}
/***********************************************************************************************************
* @名称	: 
* @描述	: 
***********************************************************************************************************/
void system_clock_config(void)
{
    en_flash_waitcycle_t      enWaitCycle;
    stc_sysctrl_pll_cfg_t     stcPLLCfg;
    
    //结构体初始化清零
    DDL_ZERO_STRUCT(stcPLLCfg);
    
    enWaitCycle = FlashWaitCycle1;
    Flash_WaitCycle(enWaitCycle);
    
    stcPLLCfg.enInFreq    = SysctrlPllInFreq4_6MHz;     //RCH 4MHz
    stcPLLCfg.enOutFreq   = SysctrlPllOutFreq36_48MHz;  //PLL 输出48MHz
    stcPLLCfg.enPllClkSrc = SysctrlPllRch;              //输入时钟源选择RCH
    stcPLLCfg.enPllMul    = SysctrlPllMul12;            //4MHz x 12 = 48MHz

    Sysctrl_SetPLLFreq(&stcPLLCfg);
    Sysctrl_SetPLLStableTime(SysctrlPllStableCycle16384);
    Sysctrl_ClkSourceEnable(SysctrlClkPLL, TRUE);  
    Sysctrl_SysClkSwitch(SysctrlClkPLL);  ///< 时钟切换
	
	 /*SysTick配置，定时1ms*/
	user_systick_config(48000);
	/*看门狗初始化*/
	watchdog_init();

}
/***********************************************************************************************************
* @名称	: 
* @描述	: 
***********************************************************************************************************/
void delay(u16 data_del)
{
	u16 i;
	u8 j,k;
	for(i=0;i<data_del;i++)
	{
		for(j=0;j<100;j++)
		k++;	
	}
}
/***********************************************END*****************************************************/

