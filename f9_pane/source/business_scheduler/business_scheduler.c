/**
*********************************************************************************************************
*                                        multi_switch_control
*                                      (c) Copyright 2021-2031
*                                         All Rights Reserved
*
* @File    : 
* @By      : liwei
* @Version : V0.01
* 
*********************************************************************************************************
**/

/*
*********************************************************************************************************
Includes 
*********************************************************************************************************
*/
#include "string.h"
#include "user_type.h"
#include "business_scheduler.h"


/*
*********************************************************************************************************
Define
*********************************************************************************************************
*/


/*
*********************************************************************************************************
Typedef
*********************************************************************************************************
*/
typedef struct irq_data_def
{
	u16 ms_clk;		
	u8 s_clk;

}irq_data_t;

irq_data_t systick_data;
data_stream_t public_null;
/*
*********************************************************************************************************
Variables
*********************************************************************************************************
*/
/*声明业务*/
extern application_template_t communication_business_operation;
extern application_template_t induction_business_operation;
extern application_template_t gpio_manage_business_operation;
extern application_template_t rgb_business_operation;
extern application_template_t logic_business_operation;

/*关联业务*/
/*业务总数量 注意：数量不能溢出否则程序跑飞*/
#define SCHEDULER_NUM  5
application_template_t* user_business[SCHEDULER_NUM]=
{
	&gpio_manage_business_operation,
	&rgb_business_operation,
	&communication_business_operation,
	&logic_business_operation,
	&induction_business_operation,
};		


static data_stream_t current_stream;
/*
*********************************************************************************************************
Function 
*********************************************************************************************************
*/
void business_data_clear(data_stream_t* stream);
/***********************************************************************************************************
* @名称	: 
* @描述	: 业务初始化
***********************************************************************************************************/	
u8 business_initialization(void)
{
	u8 i;
	for(i =0; i < SCHEDULER_NUM; i++)
	{
		user_business[i]->initialization(&current_stream);
	}
	return 0;
}
/***********************************************************************************************************
* @名称	: 
* @描述	: 读写业务
***********************************************************************************************************/	
u8 trigger_business_scheduler(void)
{
	u8 i,j;
	/*依次执行所有业务读取*/
	for(i =0; i < SCHEDULER_NUM; i++)
	{
		user_business[i]->read(&current_stream);
		/*依次执行其他业务写入*/
		for(j =0; j < SCHEDULER_NUM; j++)
		{
			/*排除自身*/
			if(i != j)
			{
				user_business[j]->write(&current_stream);		
			}		
		}
		/*清空业务数据缓存*/
		business_data_clear(&current_stream);
	}	
	return 0;
}
/***********************************************************************************************************
* @名称	: 
* @描述	: 后台持续运行业务
***********************************************************************************************************/	
u8 run_business_scheduler(void)
{
	u8 i;
	/*依次执行所有业务连续运行函数*/
	for(i =0; i < SCHEDULER_NUM; i++)
	{
		user_business[i]->run(&current_stream);
		/*清空业务数据缓存*/
		business_data_clear(&current_stream);
	}	
	return 0;
}
/***********************************************************************************************************
* @名称	: 
* @描述	:业务调度 
***********************************************************************************************************/	
u8 business_scheduler(void)
{
	/*调度触发业务*/
	trigger_business_scheduler();
	/*调度运行业务*/
	run_business_scheduler();
	return 0;	
}
/***********************************************************************************************************
* @名称	: 
* @描述	: 业务数据清空
***********************************************************************************************************/
void business_data_clear(data_stream_t* stream)
{
	stream->cmd = 0x00;
	memset(stream->buff,0,sizeof(stream->buff));
}
/***********************************************************************************************************
* @名称	: 
* @描述	: 业务中断
***********************************************************************************************************/
u8 business_interrput_scheduler(void)
{
	u8 i;
	/*依次执行所有业务中断*/
	for(i =0; i < SCHEDULER_NUM; i++)
	{
		user_business[i]->interrput(&public_null);
	}	
	return 0;	
}
	
/***********************************************************************************************************
* @名称	: 
* @描述	: 读缓存数据
***********************************************************************************************************/
u16 stream_cache_read(data_stream_cache_t* cache, data_stream_t *data )
{
	u16 return_data=0;
	if(cache->pointer > 0) /*判断发布缓存是否不为空*/
	{			
		/*复制数据*/
		memcpy(data,&cache->data[cache->pointer], sizeof(data_stream_t)); /*复制整个数据块到缓存*/

		/*清零数据 和 指针自减*/
		memset(&cache->data[cache->pointer], 0, sizeof(data_stream_t));
		cache->pointer--; 		

	}
	return return_data;
}	
/***********************************************************************************************************
* @名称	: 
* @描述	:写缓存 
***********************************************************************************************************/
void stream_cache_write(data_stream_cache_t* cache, data_stream_t *data )
{
	if(cache->pointer < (STREAM_CACHE_MAX-1)) /*缓存指针小于最大限制*/
	{
		cache->pointer++;/*指针自加，有效数据从 1 开始*/	
		memcpy(&cache->data[cache->pointer], data, sizeof(data_stream_t)); /*复制整个数据块到缓存*/
	}
}
/***********************************************************************************************************
* @名称	: 
* @描述	: 清缓存
***********************************************************************************************************/	
void data_stream_clear(data_stream_t* stream)
{
	memset(stream, 0 ,sizeof(data_stream_t));
}
/***********************************************************************************************************
* @名称	: SysTick_IRQHandler 
* @描述	: 1ms中断  处理 业务中断处理   业务中断处理 只计数和置标志位
***********************************************************************************************************/
void SysTick_IRQHandler(void)
{
	/*1ms 处理*/
	systick_data.ms_clk++;
	/*1ms业务中断调度*/
	business_interrput_scheduler();	
}
/***********************************************END*****************************************************/

