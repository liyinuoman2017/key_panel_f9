/**
*********************************************************************************************************
*                                        multi_switch_control
*                                      (c) Copyright 2021-2031
*                                         All Rights Reserved
*
* @File    : 
* @By      : liwei
* @Version : V0.01
* 
*********************************************************************************************************
**/

/*
*********************************************************************************************************
Includes 
*********************************************************************************************************
*/
#include "string.h"
#include "user_type.h"
#include "gpio_manage_business.h"
#include "gpio_manage_driver.h"
/*
*********************************************************************************************************
Define
*********************************************************************************************************
*/

#define BUTTON_BUSINESS_START  11
/*
*********************************************************************************************************
Typedef
*********************************************************************************************************
*/

/*
*********************************************************************************************************
Variables
*********************************************************************************************************
*/


static application_template_t* current_operation = &button_driver_operation;
/*
*********************************************************************************************************
Function 
*********************************************************************************************************
*/
static u8 read(data_stream_t* stream);
static u8 write(data_stream_t* stream);
static u8 initialization(data_stream_t* stream);
static u8 interrput(data_stream_t* stream);
static u8 run(data_stream_t* stream);

application_template_t gpio_manage_business_operation=
{
	.read=&read,
	.write=&write,
	.initialization=&initialization,
	.interrput=&interrput,
	.run=&run,
};


/***********************************************************************************************************
* @名称	: 
* @描述	: 
***********************************************************************************************************/
static u8 read(data_stream_t* stream)
{
	/*指令格式说明：
	 HEX0 为按键通道   HEX1 为拨码地址
	 驱动内部使用BUFF  BUFF0 通道  BUFF1 次数  BUFF2地址
	 99次读取中只有一次读取拨码*/
	static u8 clk = 0;
	stream->buff[0]=0xff;
	current_operation->read(stream);
	if((clk++%99) == 0)
	{
		/*读拨码*/		
		stream->hex[0] = stream->buff[2];
		memcpy(stream->buff,"dial",sizeof("dial"));	
		return 1;
	}
	else
	{
		/*按键*/
		if(stream->buff[0] != 0xff)
		{
			stream->hex[0] = stream->buff[0];
			memcpy(stream->buff,"button",sizeof("button"));		
			return 1;			
		}
	}
	return 0;
}

/***********************************************************************************************************
* @名称	: 
* @描述	: 
***********************************************************************************************************/
static u8 write(data_stream_t* stream)
{
		/*逻辑控制业务*/
	if(strstr((char*)(stream->buff),"lgc_out")!=NULL)
	{
		/*执行写操作*/
		current_operation->write(stream);			
	}
	return 0;
}
/***********************************************************************************************************
* @名称	: 
* @描述	: 
***********************************************************************************************************/
static u8 initialization(data_stream_t* stream)
{

	current_operation->initialization(stream);	
	return 0;
}
/***********************************************************************************************************
* @名称	: 
* @描述	: 
***********************************************************************************************************/
static u8 interrput(data_stream_t* stream)
{
	current_operation->interrput(stream);	
	return 0;
}
/***********************************************************************************************************
* @名称	: 
* @描述	: 
***********************************************************************************************************/
static u8 run(data_stream_t* stream)
{
	current_operation->run(stream);
	return 0;
}

/***********************************************END*****************************************************/

